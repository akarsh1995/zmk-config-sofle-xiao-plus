## boards/shields/sofle_xiao/Kconfig.shield
```kconfig
# Copyright (c) 2020 Ryan Cross
# SPDX-License-Identifier: MIT

config SHIELD_SOFLE_XIAO_LEFT
    def_bool $(shields_list_contains,sofle_xiao_left)

config SHIELD_SOFLE_XIAO_RIGHT
    def_bool $(shields_list_contains,sofle_xiao_right)
```

## boards/shields/soflex/Kconfig.defconfig
```kconfig
# Copyright (c) 2020 Ryan Cross
# SPDX-License-Identifier: MIT

if SHIELD_SOFLEX_LEFT

config ZMK_KEYBOARD_NAME
    default "Soflex"

config ZMK_SPLIT_ROLE_CENTRAL
    default y

endif

if SHIELD_SOFLEX_LEFT || SHIELD_SOFLEX_RIGHT

config ZMK_SPLIT
    default y

if ZMK_RGB_UNDERGLOW

config WS2812_STRIP
    default y
endif

endif
```
